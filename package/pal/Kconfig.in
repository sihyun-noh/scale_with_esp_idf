## package/pal/Kconfig.in
```kconfig
menu "PAL packages"

  menu "GPIO package"
    config GPIO_PACKAGE
      bool "GPIO package"
      default "y"
      help
        Enable GPIO module to control the devices
  endmenu # GPIO package

  menu "I2C package"
    config I2C_PACKAGE
      bool "I2C package"
      default "y"
      help
        Enable I2C module to communicate the sensors
  endmenu # I2C package

  menu "ADC package"
    config ADC_PACKAGE
      bool "ADC package"
      default "y"
      help
        Enable ADC module to get battery level of sensors
  endmenu # ADC package

  menu "DAC package"
    config DAC_PACKAGE
      bool "DAC package"
      default "n"
      help
        Enable DAC module
  endmenu # DAC package

  menu "UART package"
    config UART_PACKAGE
      bool "UART package"
      default "y"
      help
        Enable UART module to communicate the sensors
  endmenu # UART package

endmenu
```

## package/ping/Kconfig
```kconfig
config SMARTFARM_PING_FEATURE
  bool "SmartFarm ping command"
  default "y"
  help
    Ping api and command tool
```

## package/ping/Kconfig.in
```kconfig
config PING_PACKAGE
  bool "Ping package"
  default "y"
  help
    Enable Ping api and Command tool
```

## package/rtc/Kconfig.in
```kconfig
menu "RTC DS3231"

config RTC_DS3231_PACKAGE
  bool "RTC DS3231 package"
  default "y"
  help
    RTC DS3231 package to support correct local time

config DS3231_I2C_BUS
  int "DS3231 I2C BUS"
  default 0
  depends on RTC_DS3231_PACKAGE
  help
    I2C bus to be used as DS3231_I2C_BUS.

config DS3231_I2C_ADDR
  hex "DS3231 I2C ADDR"
  default 0x68
  depends on RTC_DS3231_PACKAGE
  help
    I2C address to be used as DS3231_I2C_ADDR.

config DS3231_I2C_SDA_PIN
  int "DS3231 I2C SDA PIN"
  default 33 if IDF_TARGET_ESP32
  default 1 if IDF_TARGET_ESP32S3
  depends on RTC_DS3231_PACKAGE
  help
    I2C pin number to be used as DS3231_I2C_SDA_PIN.

config DS3231_I2C_SCL_PIN
  int "DS3231 I2C SCL PIN"
  default 32 if IDF_TARGET_ESP32
  default 2 if IDF_TARGET_ESP32S3
  depends on RTC_DS3231_PACKAGE
  help
    I2C pin number to be used as DS3231_I2C_SCL_PIN.

endmenu
```

## package/sensor/Kconfig
```kconfig
menu "SmartFarm Sensors Configuration"
  config BATTERY_FEATURE
    bool "Battery feature"
    default "y"
    help
      Battery feature to get battery level of sensor

  config SHT3x_FEATURE
    bool "SHT3x feature"
    default "y"
    help
      SHT3x Temperature and Humidity Sensor
  
  config SCD4x_FEATURE
    bool "SCD4x feature"
    default "y"
    help
      SCD4x CO2 and Temperature Humidity Sensor
endmenu # Sensors
```

## package/setup/Kconfig
```kconfig
config SMARTFRAM_EASYSETUP_FEATURE
  bool "SmartFarm EasySetup feature"
  default "y"
  help
    EasySetup feature that supports zero touch setup without user intervention
```

## package/shell/Kconfig.in
```kconfig
config SHELL_PACKAGE
  bool "CommandLine package"
  default "y"
  help
    CommandLine package to run utililty and test command
```

## package/syscfg/Kconfig.in
```kconfig
config SYSCFG_PACKAGE
  bool "Syscfg package"
  default "y"
  help
    Enable Syscfg package that set and get configuration
```

## package/sysevent/Kconfig.in
```kconfig
config SYSEVENT_PACKAGE
  bool "Sysevent package"
  default "y"
  help
    Enable Sysevent package that supports event messaging between tasks.
```

## package/sysfile/Kconfig.in
```kconfig
config SYSFILE_PACKAGE
  bool "Sysfile package"
  default "n"
  help
    Enable file system that supports to save the log message.

  choice
    prompt "Filesystem Type"
    depends on SYSFILE_PACKAGE
    help
      Select filesystem type

  config LITTLEFS_PACKAGE
    bool "LittleFS package"
    help
      LittleFS filesystem package

  config SPIFFS_PACKAGE
    bool "SPIFFS package"
    help
      SPIFFS filesystem package

  endchoice
```

## package/syslog/Kconfig.in
```kconfig
config SYSLOG_PACKAGE
  bool "Syslog package"
  default "y"
  help
    Shows the log messages in console mode and add them to list.
```

## package/time/Kconfig
```kconfig
config SMARTFARM_TIMEZONE_FEATURE
  bool "SmartFarm Timezone feature"
  default "y"
  help
    TimeZone feature to support correct local time based on region
```

## package/time/Kconfig.in
```kconfig
config TIMEZONE_PACKAGE
  bool "Timezone package"
  default "y"
  help
    Enable TimeZone package to support correct local time based on region
```

## package/utils/Kconfig.in
```kconfig
config UTILS_PACKAGE
  bool "Utility package"
  default "y"
  help
    Enable Utility package to support comparison, average calculation
```

## package/wifi/Kconfig
```kconfig
config SMARTFARM_WIFILIB_FEATURE
  bool "SmartFarm WiFi library feature"
  default "y"
  help
    WiFi library that supports AP and STA mode
```

## package/wifi/Kconfig.in
```kconfig
config WIFILIB_PACKAGE
  bool "WiFi library package"
  default "y"
  help
    Enable WiFi library that supports AP and STA mode
```

## product/irrigation/hid/main/Kconfig.projbuild
```kconfig
menu "Smartfarm Package"
  rsource "../../../../package/*/Kconfig.in"
endmenu
menu "Smartfarm Features"
  rsource "../../../../features/*/Kconfig.in"
endmenu
```

## product/irrigation/master/main/Kconfig.projbuild
```kconfig
menu "Smartfarm Product"
  config PRODUCT_VENDOR
    string "Product Vendor"
    default "FIC"

  config PRODUCT_NAME
    string "Product Name"
    default "IRRIGATION_MASTER"

  config PRODUCT_SKU
    string "Product SKU"
    default ""

  choice
    prompt "Platform"
    help
      A Platform is a set tools for a particular piece of hardware/board
      It includes the package, features for making firmware.

    rsource "../../../../config/platform/0001-sensor.inc"
    rsource "../../../../config/platform/0002-actuator.inc"
    rsource "../../../../config/platform/0003-datalogger.inc"
    rsource "../../../../config/platform/0004-irrigation.inc"
  endchoice

  menu "Smartfarm Package"
    rsource "../../../../package/*/Kconfig.in"
  endmenu
  menu "Smartfarm Features"
    rsource "../../../../features/*/Kconfig.in"
  endmenu
endmenu
```

## product/measurement_system/Judge_control/main/Kconfig.projbuild
```kconfig
menu "Smartfarm Product"
  config PRODUCT_VENDOR
    string "Product Vendor"
    default "FIC"

  config PRODUCT_NAME
    string "Product Name"
    default "MEASUREMENT_SYSTEM"

  config PRODUCT_SKU
    string "Product SKU"
    default ""

  choice
    prompt "Platform"
    help 
      A Platform is a set tools for a particular piece of hardware/board
      It includes the package, features for making firmware.

    rsource "../../../../config/platform/0001-sensor.inc"
    rsource "../../../../config/platform/0002-actuator.inc"
    rsource "../../../../config/platform/0003-datalogger.inc"
    rsource "../../../../config/platform/0004-irrigation.inc"
    rsource "../../../../config/platform/0007-measurement-system.inc"
  endchoice

  menu "Smartfarm Package"
    rsource "../../../../package/*/Kconfig.in"
  endmenu
  menu "Smartfarm Features"
    rsource "../../../../features/*/Kconfig.in"
  endmenu
  menu "MSC_ota Configeration"

    config MSC_OTA_BIN_NAME
        string "msc ota bin name"
        default "usb_msc_ota.bin"

    config SIMPLE_MSC_OTA
        bool "simple msc ota"
        default y
        help
            simple msc ota

  endmenu
  menu "Print regacy Configeration"

    config PRINT_FORMAT_REGACY
        bool "dlp_format_data"
        default y
        help
            Select the format data for cas printer(y=custom, n=dlp)

  endmenu

endmenu
```

## product/measurement_system/touch_lcd_4.3/main/Kconfig.projbuild
```kconfig
	
menu "Smartfarm Product"
  config PRODUCT_VENDOR
    string "Product Vendor"
    default "FIC"

  config PRODUCT_NAME
    string "Product Name"
    default "MEASUREMENT_SYSTEM"

  config PRODUCT_SKU
    string "Product SKU"
    default ""


  menu "Smartfarm Package"
    rsource "../../../../package/*/Kconfig.in"
  endmenu
  menu "Smartfarm Features"
    rsource "../../../../features/*/Kconfig.in"
  endmenu

  menu "Configuration"
      config EXAMPLE_DOUBLE_FB
          bool "Use double Frame Buffer"
          default "n"
          help
              Enable this option, driver will allocate two frame buffers.

      config EXAMPLE_USE_BOUNCE_BUFFER
          depends on !EXAMPLE_DOUBLE_FB
          bool "Use bounce buffer"
          help
              Enable bounce buffer mode can achieve higher PCLK frequency at the cost of higher CPU consumption.

      config EXAMPLE_AVOID_TEAR_EFFECT_WITH_SEM
          depends on !EXAMPLE_DOUBLE_FB
          bool "Avoid tearing effect"
          default "y"
          help
              Enable this option, the example will use a pair of semaphores to avoid the tearing effect.
              Note, if the Double Frame Buffer is used, then we can also avoid the tearing effect without the lock.
    
    config I2C_MASTER_SCL
          int "SCL GPIO Num"
          default 6 if IDF_TARGET_ESP32C3 || IDF_TARGET_ESP32C2 || IDF_TARGET_ESP32H2
          default 9 if IDF_TARGET_ESP32 || IDF_TARGET_ESP32S2 || IDF_TARGET_ESP32S3
          help
              GPIO number for I2C Master clock line.

    config I2C_MASTER_SDA
          int "SDA GPIO Num"
          default 5 if IDF_TARGET_ESP32C3 || IDF_TARGET_ESP32C2 || IDF_TARGET_ESP32H2
          default 8 if IDF_TARGET_ESP32 || IDF_TARGET_ESP32S2 || IDF_TARGET_ESP32S3
          help
              GPIO number for I2C Master data line.

      config LCD_H_RES
          int "LCD_H_RES value"
          default 800  
          help
              rgb lcd value.
      config LCD_V_RES
          int "LCD_V_RES value"
          default 480  
          help
              rgb lcd value.

  endmenu

  menu "DDP Configuration"
    config ESP_DPP_LISTEN_CHANNEL_LIST
        string "DPP Listen channel list"
        default "6"
        help
            DPP Bootstrapping listen channels separated by commas.

    config ESP_DPP_BOOTSTRAPPING_KEY
        string "Bootstrapping key"
        help
            64 hex digits (or 32 bytes) of raw private key for DPP Bootstrapping.

    config ESP_DPP_DEVICE_INFO
        string "Additional Device Info"
        help
            Additional ancillary information to be included in QR Code.
  endmenu

  menu "Wifi Scan Configuration"

    config EXAMPLE_SCAN_LIST_SIZE
        int "Max size of scan list"
        range 0 20
        default 10
        help
            The size of array that will be used to retrieve the list of access points.

endmenu
endmenu
```
