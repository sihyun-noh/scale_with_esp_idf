## product/dajilog_display/dajilog_p4_multi_board/boards/waveshare_7b/main/Kconfig.projbuild
```kconfig
menu "DAJILOG Configuration"
    menu "Applications"
        config DAJILOG_APP_HELLO
            bool "Hello Test app"
            default y

        config DAJILOG_APP_WIFI
            bool "Wi-Fi app"
            default n
            help
                Build the common Wi-Fi application. Enable after validating
                ESP-Hosted communication with the 7B coprocessor firmware.

        config DAJILOG_APP_EEZ_DEMO
            bool "7B EEZ landscape main app"
            default y
            help
                Build the 1024x600 EEZ Studio application stored under this
                board target. Generated UI files remain board-specific while
                ui_adaptor, ui_bridge and ui_msg are shared components.

        choice DAJILOG_FIRMWARE_UPDATE_METHOD
            prompt "Firmware update method"
            default DAJILOG_UPDATE_DISABLED

            config DAJILOG_UPDATE_DISABLED
                bool "Disabled"
            config DAJILOG_UPDATE_PC_USB
                bool "PC USB Update (USB Device)"
            config DAJILOG_UPDATE_USB_MEMORY
                bool "USB Memory Update (USB Host)"
        endchoice
    endmenu

    menu "Diagnostics"
        config DAJILOG_SETTINGS_DEBUG_LOG
            bool "Print settings values in debug logs"
            default n
            help
                Print staged and saved setting values. Validation and storage
                errors are still logged when this option is disabled.

        config DAJILOG_APP_CAN_DIAGNOSTIC
            bool "CAN Diagnostic app"
            depends on DAJILOG_CAN_ENABLE
            default n

        config DAJILOG_CAN_DEBUG_LOG
            bool "Print raw CAN frames in debug logs"
            depends on DAJILOG_CAN_ENABLE
            default n
    endmenu

    menu "CAN"
        config DAJILOG_CAN_ENABLE
            bool "Enable CAN service"
            default n

        config DAJILOG_CAN_TX_GPIO
            int "CAN TX GPIO"
            depends on DAJILOG_CAN_ENABLE
            default -1

        config DAJILOG_CAN_RX_GPIO
            int "CAN RX GPIO"
            depends on DAJILOG_CAN_ENABLE
            default -1

        config DAJILOG_CAN_TRANSCEIVER_ENABLE_GPIO
            int "Transceiver enable GPIO (-1 if unused)"
            depends on DAJILOG_CAN_ENABLE
            default -1
    endmenu
endmenu
```

## product/measurement_system/ezz_lvgl/main/Kconfig.projbuild
```kconfig
	
menu "AGMO Product"
  config PRODUCT_VENDOR
    string "Product Vendor"
    default "AGMO"

  config PRODUCT_NAME
    string "Product Name"
    default "MEASUREMENT_SYSTEM"

  config PRODUCT_SKU
    string "Product SKU"
    default ""


  menu "Mylcd Features"
    rsource "../components/waveshare_lcd/Kconfig.in"
  endmenu

  menu "Configuration"
      config EXAMPLE_DOUBLE_FB
          bool "Use double Frame Buffer"
          default "n"
          help
              Enable this option, driver will allocate two frame buffers.

      config EXAMPLE_USE_BOUNCE_BUFFER
          depends on !EXAMPLE_DOUBLE_FB
          bool "Use bounce buffer"
          help
              Enable bounce buffer mode can achieve higher PCLK frequency at the cost of higher CPU consumption.

      config EXAMPLE_AVOID_TEAR_EFFECT_WITH_SEM
          depends on !EXAMPLE_DOUBLE_FB
          bool "Avoid tearing effect"
          default "y"
          help
              Enable this option, the example will use a pair of semaphores to avoid the tearing effect.
              Note, if the Double Frame Buffer is used, then we can also avoid the tearing effect without the lock.
    
      config I2C_MASTER_SCL
          int "SCL GPIO Num"
          default 6 if IDF_TARGET_ESP32C3 || IDF_TARGET_ESP32C2 || IDF_TARGET_ESP32H2
          default 9 if IDF_TARGET_ESP32 || IDF_TARGET_ESP32S2 || IDF_TARGET_ESP32S3
          help
              GPIO number for I2C Master clock line.

      config I2C_MASTER_SDA
          int "SDA GPIO Num"
          default 5 if IDF_TARGET_ESP32C3 || IDF_TARGET_ESP32C2 || IDF_TARGET_ESP32H2
          default 8 if IDF_TARGET_ESP32 || IDF_TARGET_ESP32S2 || IDF_TARGET_ESP32S3
          help
              GPIO number for I2C Master data line.

      config LCD_H_RES
          int "LCD_H_RES value"
          default 800  
          help
              rgb lcd value.
      config LCD_V_RES
          int "LCD_V_RES value"
          default 480  
          help
              rgb lcd value.

    config EXAMPLE_TX_GPIO_NUM
        int "TX GPIO number"
        default 21 if IDF_TARGET_ESP32
        default 0
        help
            This option selects the GPIO pin used for the TX signal. Connect the
            TX signal to your transceiver.

    config EXAMPLE_RX_GPIO_NUM
        int "RX GPIO number"
        default 22 if IDF_TARGET_ESP32
        default 2
        help
            This option selects the GPIO pin used for the RX signal. Connect the
            RX signal to your transceiver.


    config TARGET_WAVESHARE_4_3
        bool "Waveshare 4.3 inch"

    config TARGET_WAVESHARE_5
        bool "Waveshare 5 inch"

    choice APP_RUN_MODE
        prompt "Application Run Mode"
        default APP_RUN_MODE_SIBI
        help
            Select which runtime module to start after common initialization.

        config APP_RUN_MODE_SIBI
            bool "SIBI monitor"

        config APP_RUN_MODE_UPPER
            bool "Upper task"
    endchoice

endmenu

    menu "Wifi Scan Configuration"

    config EXAMPLE_SCAN_LIST_SIZE
        int "Max size of scan list"
        range 0 20
        default 10
        help
            The size of array that will be used to retrieve the list of access points.

  endmenu



endmenu
```
