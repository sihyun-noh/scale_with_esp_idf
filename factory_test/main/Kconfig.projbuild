## features/espnow_gateway/Kconfig.in
```kconfig
config ESPNOW_GATEWAY_FEATURE
  bool "ESPNOW WiFi Gateway feature"
  default "n"
  help
    Enable ESPNOW WiFi Gateway that can access to the internet.
```

## features/filelog/Kconfig.in
```kconfig
config FILELOG_FEATURE
  bool "Filelog feature"
  default "n"
  select SYSFILE_PACKAGE
  help
    Enable to save log messages to the file system.
```

## features/monitor/Kconfig.in
```kconfig
config MONITOR_FEATURE
  bool "Monitoring feature"
  depends on PING_PACKAGE
  help
    Enable monitoring the system status.
```

## features/ota/Kconfig.in
```kconfig
config OTA_FEATURE
  bool "OTA Firmware update feature"
  default "y"
  depends on SYSCFG_PACKAGE
  depends on SYSEVENT_PACKAGE
  help
    Enable OTA Firmware Update
```

## features/sensor/Kconfig.in
```kconfig
menu "Sensors Features"

  config SHT3X_FEATURE
    bool "SHT3x feature"
    default "n"
    help
      SHT3x Temperature and Humidity Sensor

  config SCD4X_FEATURE
    bool "SCD4x feature"
    default "n"
    help
      SCD4x CO2 and Temperature Humidity Sensor

  config ATLAS_PH_FEATURE
    bool "Atlas pH feature"
    default "n"
    help
      Atlas pH Sensor

  config ATLAS_EC_FEATURE
    bool "Atlas EC feature"
    default "n"
    help
      Atlas EC Sensor

  rsource "winsen_ze03/Kconfig.in"
  rsource "winsen_zce04b/Kconfig.in"
  rsource "th01/Kconfig.in"

endmenu # Sensors
```

## features/sensor/th01/Kconfig.in
```kconfig
  menu "TH01 feature"

    config TH01_FEATURE
      bool "TH01 feature"
      default "n"
      help
        TH01 Air temperature and humidity Sensor

    config TH01_UART_NUM
      depends on TH01_FEATURE
      int "TH01 UART port number"
      range 0 2
      default 1
      help
        UART communication port number for the TH01

    config TH01_UART_BAUDRATE
      depends on TH01_FEATURE
      int "TH01 UART communication speed"
      range 1200 115200
      default 19200
      help
        UART communication speed for the TH01

    config TH01_UART_RXD
      depends on TH01_FEATURE
      int "TH01 UART RXD pin number"
      default 18
      help
        GPIO number for UART RX pin

    config TH01_UART_TXD
      depends on TH01_FEATURE
      int "TH01 UART TXD pin number"
      default 17
      help
        GPIO number for UART TX pin

    config TH01_UART_RXBUF_SIZE
      depends on TH01_FEATURE
      int "TH01 UART rx buffer size"
      default 2048
      help
        UART rx buffer size for the TH01

    config TH01_UART_TXBUF_SIZE
      depends on TH01_FEATURE
      int "TH01 UART tx buffer size"
      default 0
      help
        UART tx buffer size for the TH01

  endmenu
```

## features/sensor/winsen_zce04b/Kconfig.in
```kconfig
  menu "Winsen ZCE04B feature"

    config WINSEN_ZCE04B_FEATURE
      bool "Winsen ZCE04B feature"
      default "n"
      help
        Winsen ZCE04B NH3 Gas Sensor

    config ZCE04B_UART_NUM
      depends on WINSEN_ZCE04B_FEATURE
      int "ZCE04B UART port number"
      range 0 2
      default 1
      help
        UART communication port number for the Winsen ZCE04B

    config ZCE04B_UART_BAUDRATE
      depends on WINSEN_ZCE04B_FEATURE
      int "ZCE04B UART communication speed"
      range 1200 115200
      default 9600
      help
        UART communication speed for the Winsen ZCE04B

    config ZCE04B_UART_RXD
      depends on WINSEN_ZCE04B_FEATURE
      int "ZCE04B UART RXD pin number"
      default 18
      help
        GPIO number for UART RX pin

    config ZCE04B_UART_TXD
      depends on WINSEN_ZCE04B_FEATURE
      int "ZCE04B UART TXD pin number"
      default 17
      help
        GPIO number for UART TX pin

    config ZCE04B_UART_RXBUF_SIZE
      depends on WINSEN_ZCE04B_FEATURE
      int "ZCE04B UART rx buffer size"
      default 2048
      help
        UART rx buffer size for the Winsen ZCE04B

    config ZCE04B_UART_TXBUF_SIZE
      depends on WINSEN_ZCE04B_FEATURE
      int "ZCE04B UART tx buffer size"
      default 0
      help
        UART tx buffer size for the Winsen ZCE04B

  endmenu
```

## features/sensor/winsen_ze03/Kconfig.in
```kconfig
  menu "Winsen ZE03 feature"

    config WINSEN_ZE03_FEATURE
      bool "Winsen ZE03 feature"
      default "n"
      help
        Winsen ZE03 NH3 Gas Sensor

    config ZE03_UART_NUM
      depends on WINSEN_ZE03_FEATURE
      int "ZE03 UART port number"
      range 0 2
      default 1
      help
        UART communication port number for the Winsen ZE03

    config ZE03_UART_BAUDRATE
      depends on WINSEN_ZE03_FEATURE
      int "ZE03 UART communication speed"
      range 1200 115200
      default 9600
      help
        UART communication speed for the Winsen ZE03

    config ZE03_UART_RXD
      depends on WINSEN_ZE03_FEATURE
      int "ZE03 UART RXD pin number"
      default 18
      help
        GPIO number for UART RX pin

    config ZE03_UART_TXD
      depends on WINSEN_ZE03_FEATURE
      int "ZE03 UART TXD pin number"
      default 17
      help
        GPIO number for UART TX pin

    config ZE03_UART_RXBUF_SIZE
      depends on WINSEN_ZE03_FEATURE
      int "ZE03 UART rx buffer size"
      default 2048
      help
        UART rx buffer size for the Winsen ZE03

    config ZE03_UART_TXBUF_SIZE
      depends on WINSEN_ZE03_FEATURE
      int "ZE03 UART tx buffer size"
      default 0
      help
        UART tx buffer size for the Winsen ZE03

  endmenu
```

## features/setup/Kconfig.in
```kconfig
config EASYSETUP_FEATURE
  bool "EasySetup feature"
  depends on WIFILIB_PACKAGE
  help
    Enable EasySetup feature that supports zero touch setup without user intervention
```

## features/touch_lcd/Kconfig.in
```kconfig
config LCD_RGB_16BIT_GT911_FEATURE
  bool "LCD panel with RGB 16bit and touch GT911 feature"
  depends on IDF_TARGET_ESP32S3
  default "n"
  help
    This setup is a 4.3-inch LCD using RGB16bit interface and GT911 touch interface.
    
```

## features/usbhost/Kconfig.in
```kconfig
config USB_HOST_FEATURE
  bool "USB Host feature"
  depends on IDF_TARGET_ESP32S3
  default "n"
  help
    Enable USB_HOST_MSC feature that supports USB Mass Storage Class
```

## package/async_mqtt/Kconfig.in
```kconfig
config ASYNC_MQTT_PACKAGE
  bool "Async MQTT client package"
  default n 
  help 
    Enable Async MQTT client 
```

## package/controller/Kconfig.in
```kconfig
menu "Controller package"
  config LED_PACKAGE
    bool "LED package"
    default "y"
    help
      LED module to set led status

endmenu # Controller
```

## package/espnow/Kconfig.in
```kconfig
config ESPNOW_PACKAGE
  bool "ESPNOW package"
  default "n"
  help
    Enable ESPNOW package
```

## package/ethernet/Kconfig.in
```kconfig
config ETHERNET_PACKAGE
  bool "Ethernet package"
  default "n"
  help
    Enable Ethernet module 
```

## package/file_copy/Kconfig.in
```kconfig
config FILECOPY_PACKAGE
  bool "File copy package"
  default "n"
  help
    Enable File copy package to support file copy
```

## package/lfs/Kconfig.in
```kconfig
config LITTLEFS_ENABLE
  bool "SmartFarm LittleFS feature"
  default "n"
  help
    LittleFS filesystem feature
```

## package/lwmqttc/Kconfig.in
```kconfig
menu "LWMQTT package"

config LWMQTT_ENABLED
    bool "Enable the Lightweight MQTT component"
    select LWIP_SO_RCVBUF
    default y
    help
        This is currently only used to enforce the selection of LWIP_SO_RCVBUF.
        Disabling the component does not actually disable something.

config LWMQTT_TASK_STACK_SIZE
    int "MQTT background process task stack size"
        depends on LWMQTT_ENABLED
    default 9216
    help
        Specify at least 9216 if TLS is used and at least 4096 otherwise.

config LWMQTT_TASK_STACK_PRIORITY
    int "MQTT background process task priority"
    depends on LWMQTT_ENABLED
    default 5

config LWMQTT_EVENT_QUEUE_SIZE
    int "MQTT event queue size"
    depends on LWMQTT_ENABLED
    default 64
    help
        This value defines the amount of messages that are queued during various
        calls and dispatched by the background process.

config LWMQTT_TLS_ENABLE
   bool "Enable TLS connection"
   depends on LWMQTT_ENABLED
   default y
   help
        You can deactivate TLS to save space in memory and flash.

endmenu
```

## package/modbus/Kconfig.in
```kconfig
config MODBUS_PACKAGE
  bool "Modbus package"
  default "n"
  help
    Enable Modbus module for RS485 Sensors 
```

## package/monitor/Kconfig.in
```kconfig
config SMARTFARM_MONITOR_FEATURE
  bool "SmartFarm monitor feature"
  default "y"
  help
    Smartfarm system monitor feature.
```

## package/mqttc/Kconfig
```kconfig
config SMARTFARM_MQTT_FEATURE
  bool "SmartFarm MQTT feature"
  default "y"
  help
    MQTT feature that supports MQTT client
```

## package/mqttc/Kconfig.in
```kconfig
config MQTTC_PACKAGE
  bool "MQTT client package"
  default "y"
  help
    Enable MQTT client package
```

## package/msc/Kconfig.in
```kconfig
config SMARTFARM_USB_HOST_MSC_FEATURE
  bool "SmartFarm USB Host MSC feature"
  depends on IDF_TARGET_ESP32S3
  default "y"
  help
    USB_HOST_MSC feature that supports USB Mass Storage Class
```

## package/ota/Kconfig.in
```kconfig
config SMARTFARM_OTA_FEATURE
  bool "SmartFarm OTA FW update"
  default "y"
  help
    SmartFarm OTA FW Update
```
