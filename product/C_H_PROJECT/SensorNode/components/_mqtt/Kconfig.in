## product/C_H_PROJECT/SensorNode/components/_mqtt/Kconfig.in
```kconfig
menu "MQTT Configuration"

    config MQTT_CMD_AUTO_REGISTRATION
        bool "Enable Console command mqtt Auto-registration"
        default y
        help
            Enabling this allows for the autoregistration of the mqtt command.


     choice MQTT_BROKER_SELECTION
        prompt "Select MQTT Broker"
        default MQTT_BROKER_REMOTE

        config MQTT_BROKER_LOCAL
            bool "Local broker (192.168.50.12:1884)"

        config MQTT_BROKER_REMOTE
            bool "Remote broker (115.143.224.112)"

        config MQTT_BROKER_LOCAL_CAH
            bool "Local broker (192.168.50.100:1883)"
    
        config MQTT_BROKER_REMOTE_CAH
            bool "Remote broker (121.156.164.156:11883)"

        config MQTT_BROKER_REMOTE_CAH_NEW
            bool "Remote broker (119.30.165.250:11883)"


    endchoice

    config MQTT_BROKER_URL
        string
        default "mqtt://192.168.50.12:1884" if MQTT_BROKER_LOCAL
        default "mqtt://115.143.224.112:11883" if MQTT_BROKER_REMOTE
        default "mqtt://192.168.50.100:1883" if MQTT_BROKER_LOCAL_CAH
        default "mqtt://121.156.164.156:11883" if MQTT_BROKER_REMOTE_CAH
        default "mqtt://119.30.165.250:11883" if MQTT_BROKER_REMOTE_CAH_NEW

        help
            URL or IP address of the broker to connect to

   
    # config MQTT_BROKER_URL
    #     string "Broker URL or IP address"
    #     #default "mqtt://192.168.50.12:1884"
    #     default "mqtt://115.143.224.112:11883"
    #     help
    #         URL or IP address of the broker to connect to




endmenu
```

## product/C_H_PROJECT/SensorNode/components/_nvs/Kconfig.in
```kconfig
menu "NVS Configuration"

    config NVS_CMD_AUTO_REGISTRATION
        bool "Enable Console command NVS Auto-registration"
        default y
        help
            Enabling this allows for the autoregistration of the Console command.


endmenu
```

## product/C_H_PROJECT/SensorNode/components/_ota/Kconfig.in
```kconfig
menu "Example Configuration"

    config OTA_FIRMWARE_UPGRADE_URL
        string "firmware upgrade url endpoint"
        default "https://192.168.0.3:8070/hello_world.bin"
        help
            URL of server which hosts the firmware
            image.

    config OTA_USE_CERT_BUNDLE
        bool "Enable certificate bundle"
        default y
        depends on MBEDTLS_CERTIFICATE_BUNDLE
        help
            Enable trusted root certificate bundle. This approach allows to have
            OTA updates functional with any public server without requirement
            to explicitly add its server certificate.

    config OTA_FIRMWARE_UPGRADE_URL_FROM_STDIN
        bool
        default y if OTA_FIRMWARE_UPGRADE_URL = "FROM_STDIN"

    config OTA_SKIP_COMMON_NAME_CHECK
        bool "Skip server certificate CN fieldcheck"
        default n
        help
            This allows you to skip the validation of OTA server certificate CN field.

    config OTA_FIRMWARE_UPGRADE_BIND_IF
        bool "Support firmware upgrade bind specified interface"
        default n
        help
            This allows you to bind specified interface in OTA example.

    choice OTA_FIRMWARE_UPGRADE_BIND_IF_TYPE
        prompt "Choose OTA data bind interface"
        default OTA_FIRMWARE_UPGRADE_BIND_IF_STA
        depends on OTA_FIRMWARE_UPGRADE_BIND_IF
        help
            Select which interface type of OTA data go through.

        config OTA_FIRMWARE_UPGRADE_BIND_IF_STA
            bool "Bind wifi station interface"
            depends on OTA_CONNECT_WIFI
            help
                Select wifi station interface to pass the OTA data.

        config OTA_FIRMWARE_UPGRADE_BIND_IF_ETH
            bool "Bind ethernet interface"
            depends on OTA_CONNECT_ETHERNET
            help
                Select ethernet interface to pass the OTA data.
    endchoice
endmenu
```

## product/C_H_PROJECT/SensorNode/components/bsp_component/bsp_gpio/Kconfig.in
```kconfig
menu "BSP GPIO Configuration"

    config STATUS_LED_BLUE_PIN
        int "LED BLUE Control GPIO"
        default 41

    config STATUS_LED_GREEN_PIN
        int "LED GREEM Control GPIO"
        default 42

    config STATUS_LED_RED_PIN
        int "LED RED Control GPIO"
        default 45

    config WIFI_SELECT_PIN
        int "WIFI SELECT PIN GPIO"
        default 47

    config LAN_SELECT_PIN
        int "LAN ETH SELECT PIN GPIO"
        default 48


endmenu
```

## product/C_H_PROJECT/SensorNode/components/bsp_component/sdi12/Kconfig.in
```kconfig
menu "SDI-12 Configuration"

    config SDI12_BREAK_TIME_MS
        int "Break time (ms)"
        default 12
        range 12 1000
        help
            The break time signal duration sent before a command.
            According to SDI-12 spec, must be at least 12 ms.

    config SDI12_MARKING_TIME_MS
        int "Marking time (ms)"
        default 9
        range 9 1000
        help
            The marking time duration following the break signal.
            According to SDI-12 spec, must be at least 8.33 ms.

    config SDI12_MAX_RESPONSE_WAIT_MS
        int "Maximum response wait time (ms)"
        default 15
        range 1 1000
        help
            The sensor must start responding within this time after a command is sent.

    config SDI12_OE_PIN
        int "Enable Output (OE) GPIO Pin"
        default 16
        help
            GPIO pin used to control the Enable Output for SDI-12 transceiver.

    config SDI12_RX_PIN
        int "RX GPIO Pin"
        default 18
        help
            GPIO pin connected to the RX (receive) line of the SDI-12 bus.

    config SDI12_TX_PIN
        int "TX GPIO Pin"
        default 17
        help
            GPIO pin connected to the TX (transmit) line of the SDI-12 bus.

    config SENSOR_BUFFER_ENABLE_PIN
        int "Buffer Enable GPIO Pin (Active Low)"
        default 1 
 
    config SENSOR_BUFFER_S0_PIN
        int "Buffer Select S0 GPIO Pin"
        default 2

    config SENSOR_BUFFER_S1_PIN
        int "Buffer Select S1 GPIO Pin"
        default 3

     config SENSOR_BUFFER_S2_PIN
        int "Buffer Select S2 GPIO Pin"
        default 4


    config SENSOR_PORT_0_DETECT_PIN
        int "Sensor Port 0 Detect GPIO"
        default 19

    config SENSOR_PORT_0_CTRL_PIN
        int "Sensor Port 0 Control GPIO"
        default 38

    config SENSOR_PORT_1_DETECT_PIN
        int "Sensor Port 1 Detect GPIO"
        default 20

    config SENSOR_PORT_1_CTRL_PIN
        int "Sensor Port 1 Control GPIO"
        default 39

    config SENSOR_PORT_2_DETECT_PIN
        int "Sensor Port 2 Detect GPIO"
        default 21

    config SENSOR_PORT_2_CTRL_PIN
        int "Sensor Port 2 Control GPIO"
        default 40

    config SENSOR_PORT_3_DETECT_PIN
        int "Sensor Port 3 Detect GPIO"
        default 35

    config SENSOR_PORT_3_CTRL_PIN
        int "Sensor Port 3 Control GPIO"
        default 41

    config SENSOR_PORT_4_DETECT_PIN
        int "Sensor Port 4 Detect GPIO"
        default 36

    config SENSOR_PORT_4_CTRL_PIN
        int "Sensor Port 4 Control GPIO"
        default 42

    config SENSOR_PORT_5_DETECT_PIN
        int "Sensor Port 5 Detect GPIO"
        default 37

    config SENSOR_PORT_5_CTRL_PIN
        int "Sensor Port 5 Control GPIO"
        default 45


endmenu
```

## product/C_H_PROJECT/SensorNode/main/Kconfig.projbuild
```kconfig
menu "C&H Sensor Node Porduct"
  config PRODUCT_VENDOR
      string "Product Vendor"
      default "C&H"

    config PRODUCT_NAME
      string "Product Name"
      default "SENSOR-SDI12"

    config PRODUCT_SKU
      string "Product SKU"
      default ""

menu "Main Server Configuration"

config SERVER_URL
    string "Main Server URL"
    default ""
    help
        Specify the base URL of the main server.
        Example: 192.168.1.100:1880

config USE_HTTPS
    bool "Use HTTPS for Upload"
    default y
    help
        Enable this option to use HTTPS instead of HTTP
        when performing file uploads or OTA firmware updates.

config USE_CERT_BUNDLE
    bool "Use TLS Certificate PEM Bundle"
    depends on USE_HTTPS
    default y
    help
        Enable this option to include a TLS certificate bundle (PEM format)
        for verifying the server during HTTPS communication.

config CERT_BUNDLE_NAME
    string "Server certificate symbol name"
    depends on USE_CERT_BUNDLE
    default "ca_cert_pem"
    help
        Specify the symbol name used to reference the embedded certificate.
        For example, if the file is named `ca_cert.pem` and included via CMake,
        it will typically be available as `_binary_ca_cert_pem_start`.

endmenu

  menu "Ethernet Driver Configuration"
    rsource "../components/bsp_component/ethernet_driver/Kconfig.in"
  endmenu

  menu "NVS Configuration"
    rsource "../components/_nvs/Kconfig.in"
  endmenu
  
  menu "MQTT Configuration"
    rsource "../components/_mqtt/Kconfig.in"

  endmenu

  menu "SDI-12 Configuration"
    rsource "../components/bsp_component/sdi12/Kconfig.in"

  endmenu

  menu "GPIO Configuration"
    rsource "../components/bsp_component/bsp_gpio/Kconfig.in"

  endmenu

  menu "SYSFILE Configuration"
    rsource "../components/sysfile/Kconfig.in"

  endmenu

  menu "OTA Configuration"
    rsource "../components/_ota/Kconfig.in"

  endmenu


endmenu
```

## product/C_H_PROJECT/SensorNode/sdkconfig.defaults
```kconfig
#
CONFIG_AUTOSTART_ARDUINO=n
# end of Arduino ESP32

#
# FREERTOS
#
CONFIG_FREERTOS_HZ=1000
# end of FREERTOS
# end of Component config
#
#
#
# Serial flasher config
#
# CONFIG_ESPTOOLPY_NO_STUB is not set
# CONFIG_ESPTOOLPY_OCT_FLASH is not set
CONFIG_ESPTOOLPY_FLASH_MODE_AUTO_DETECT=y
# CONFIG_ESPTOOLPY_FLASHMODE_QIO is not set
# CONFIG_ESPTOOLPY_FLASHMODE_QOUT is not set
CONFIG_ESPTOOLPY_FLASHMODE_DIO=y
# CONFIG_ESPTOOLPY_FLASHMODE_DOUT is not set
CONFIG_ESPTOOLPY_FLASH_SAMPLE_MODE_STR=y
CONFIG_ESPTOOLPY_FLASHMODE="dio"
# CONFIG_ESPTOOLPY_FLASHFREQ_120M is not set
CONFIG_ESPTOOLPY_FLASHFREQ_80M=y
# CONFIG_ESPTOOLPY_FLASHFREQ_40M is not set
# CONFIG_ESPTOOLPY_FLASHFREQ_20M is not set
CONFIG_ESPTOOLPY_FLASHFREQ_80M_DEFAULT=y
CONFIG_ESPTOOLPY_FLASHFREQ="80m"
# CONFIG_ESPTOOLPY_FLASHSIZE_1MB is not set
# CONFIG_ESPTOOLPY_FLASHSIZE_2MB is not set
# CONFIG_ESPTOOLPY_FLASHSIZE_4MB is not set
# CONFIG_ESPTOOLPY_FLASHSIZE_8MB is not set
CONFIG_ESPTOOLPY_FLASHSIZE_16MB=y
# CONFIG_ESPTOOLPY_FLASHSIZE_32MB is not set
# CONFIG_ESPTOOLPY_FLASHSIZE_64MB is not set
# CONFIG_ESPTOOLPY_FLASHSIZE_128MB is not set
CONFIG_ESPTOOLPY_FLASHSIZE="16MB"
# CONFIG_ESPTOOLPY_HEADER_FLASHSIZE_UPDATE is not set
CONFIG_ESPTOOLPY_BEFORE_RESET=y
# CONFIG_ESPTOOLPY_BEFORE_NORESET is not set
CONFIG_ESPTOOLPY_BEFORE="default_reset"
CONFIG_ESPTOOLPY_AFTER_RESET=y
# CONFIG_ESPTOOLPY_AFTER_NORESET is not set
CONFIG_ESPTOOLPY_AFTER="hard_reset"
CONFIG_ESPTOOLPY_MONITOR_BAUD=115200
# end of Serial flasher config

# Partition Table
#
# CONFIG_PARTITION_TABLE_SINGLE_APP is not set
# CONFIG_PARTITION_TABLE_SINGLE_APP_LARGE is not set
# CONFIG_PARTITION_TABLE_TWO_OTA is not set
CONFIG_PARTITION_TABLE_CUSTOM=y
CONFIG_PARTITION_TABLE_CUSTOM_FILENAME="partitions.csv"
CONFIG_PARTITION_TABLE_FILENAME="partitions.csv"
CONFIG_PARTITION_TABLE_OFFSET=0x8000
CONFIG_PARTITION_TABLE_MD5=y
# end of Partition Table

#
# SYSFILE Configuration
#
CONFIG_SYSFILE_PACKAGE=y
CONFIG_LITTLEFS_PACKAGE=y
# CONFIG_SPIFFS_PACKAGE is not set
# end of SYSFILE Configuration

# board version 0.4
#
# SDI-12 Configuration
#
CONFIG_SDI12_BREAK_TIME_MS=12
CONFIG_SDI12_MARKING_TIME_MS=9
CONFIG_SDI12_MAX_RESPONSE_WAIT_MS=15
CONFIG_SDI12_OE_PIN=16
CONFIG_SDI12_RX_PIN=18
CONFIG_SDI12_TX_PIN=17
CONFIG_SENSOR_BUFFER_ENABLE_PIN=1
CONFIG_SENSOR_BUFFER_S0_PIN=2
CONFIG_SENSOR_BUFFER_S1_PIN=3
CONFIG_SENSOR_BUFFER_S2_PIN=4
CONFIG_SENSOR_PORT_0_DETECT_PIN=35
CONFIG_SENSOR_PORT_0_CTRL_PIN=5
CONFIG_SENSOR_PORT_1_DETECT_PIN=36
CONFIG_SENSOR_PORT_1_CTRL_PIN=6
CONFIG_SENSOR_PORT_2_DETECT_PIN=37
CONFIG_SENSOR_PORT_2_CTRL_PIN=7
CONFIG_SENSOR_PORT_3_DETECT_PIN=38
CONFIG_SENSOR_PORT_3_CTRL_PIN=8
CONFIG_SENSOR_PORT_4_DETECT_PIN=39
CONFIG_SENSOR_PORT_4_CTRL_PIN=15
CONFIG_SENSOR_PORT_5_DETECT_PIN=40
CONFIG_SENSOR_PORT_5_CTRL_PIN=19
# end of SDI-12 Configuration

#LED RGB GPIO
CONFIG_STATUS_LED_BLUE_PIN=41
CONFIG_STATUS_LED_GREEN_PIN=42
CONFIG_STATUS_LED_RED_PIN=45

#GPIO INPUT PIN

CONFIG_STATUS_WIFI_PIN=48
CONFIG_STATUS_LAN_PIN=47
```

## product/dajilog_display/dajilog_p4_multi_board/boards/waveshare_5/main/Kconfig.projbuild
```kconfig
menu "DAJILOG Configuration"
    menu "Applications"
        config DAJILOG_APP_HELLO
            bool "Hello Test app"
            default y

        config DAJILOG_APP_WIFI
            bool "Wi-Fi app"
            default y

        config DAJILOG_APP_EEZ_DEMO
            bool "5-inch EEZ portrait main app"
            default y
            help
                Build the 720x1280 EEZ Studio application stored under this
                board target. This application is not shared with the 7B.

        choice DAJILOG_FIRMWARE_UPDATE_METHOD
            prompt "Firmware update method"
            default DAJILOG_UPDATE_USB_MEMORY

            config DAJILOG_UPDATE_DISABLED
                bool "Disabled"
            config DAJILOG_UPDATE_PC_USB
                bool "PC USB Update (USB Device)"
            config DAJILOG_UPDATE_USB_MEMORY
                bool "USB Memory Update (USB Host)"
        endchoice
    endmenu

    menu "Diagnostics"
        config DAJILOG_SETTINGS_DEBUG_LOG
            bool "Print settings values in debug logs"
            default n
            help
                Print staged and saved setting values. Validation and storage
                errors are still logged when this option is disabled.

        config DAJILOG_CAN_DEBUG_LOG
            bool
            default n
    endmenu

    config DAJILOG_CAN_ENABLE
        bool
        default n

    config DAJILOG_CAN_TX_GPIO
        int
        default -1

    config DAJILOG_CAN_RX_GPIO
        int
        default -1

    config DAJILOG_CAN_TRANSCEIVER_ENABLE_GPIO
        int
        default -1
endmenu
```
